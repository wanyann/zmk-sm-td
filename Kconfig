## Kconfig
```kconfig
menu "SM_TD Options"

config ZMK_SM_TD_POOL_SIZE
    int "Max concurrent active sm_td states"
    default 10

config ZMK_SM_TD_DEFAULT_TAP_TERM_MS
    int "Default tap timeout (ms)"
    default 200

config ZMK_SM_TD_DEFAULT_SEQUENCE_TERM_MS
    int "Default sequence timeout (ms)"
    default 100

config ZMK_SM_TD_DEFAULT_RELEASE_TERM_MS
    int "Default release timeout (ms)"
    default 50

config ZMK_SM_TD_DYNAMIC_RELEASE
    bool "Enable dynamic release term"
    default y

config ZMK_SM_TD_RELEASE_PERCENT
    int "Dynamic release window percent (0=disabled)"
    default 30

config ZMK_SM_TD_AGGREGATE_TAPS
    bool "Aggregate taps before resolving"
    default n

config ZMK_SM_TD_DEBUG
    bool "Enable SM_TD debug logging"
    default n

config SM_TD_LOG_LEVEL
    int "SM_TD log level (0=off 1=error 2=warning 3=info 4=debug)"
    default 4 if ZMK_SM_TD_DEBUG
    default 1

endmenu

DT_COMPAT_ZMK_BEHAVIOR_SM_TD := zmk,behavior-sm-td

config ZMK_BEHAVIOR_SM_TD
    bool
    default $(dt_compat_enabled,$(DT_COMPAT_ZMK_BEHAVIOR_SM_TD))
```

## dts/bindings/behaviors/zmk,behavior-sm-td.yaml
```yaml
# Copyright (c) 2026 Stanislav Markin (https://github.com/stasmarkin)
# SPDX-License-Identifier: MIT
description: SM Tap-Dance Behavior
compatible: "zmk,behavior-sm-td"
include: two_param.yaml
properties:
  bindings:
    type: phandles
    required: true
  tap-term-ms:
    type: int
    default: 200
  sequence-term-ms:
    type: int
    default: 100
  release-term-ms:
    type: int
    default: 50
  release-percent:
    type: int
    default: 30
  aggregate-taps:
    type: boolean
```
